## buildroot/package-patches/op3-initramfs/Config.in
```kconfig
config BR2_PACKAGE_OP3_INITRAMFS
	bool "op3 self-built initramfs"
	help
	  Install the project-owned initramfs entrypoint, inittab, mainline
	  startup scripts, recovery launcher, audio route helper, and static
	  diagnostics into the Buildroot CPIO image.
```

## buildroot/package-patches/op3-recovery/Config.in
```kconfig
config BR2_PACKAGE_OP3_RECOVERY
	bool "op3 recovery"
	help
	  Build the direct-DRM OnePlus 3 recovery terminal and install its
	  browser-session helpers into the persistent recovery target.
```
